#include "effect_clock.h"
#include "lib/logger.h"
#include "protogen.h"


namespace toaster {


static const uint8_t PROGMEM IMAGE_CLOCK[] = {
  0x89, 0x50, 0x4e, 0x47, 0x0d, 0x0a, 0x1a, 0x0a, 0x00, 0x00, 0x00, 0x0d, 0x49, 0x48, 0x44, 0x52,
  0x00, 0x00, 0x00, 0x58, 0x00, 0x00, 0x00, 0x0a, 0x08, 0x06, 0x00, 0x00, 0x00, 0x30, 0xd3, 0x99,
  0xc8, 0x00, 0x00, 0x00, 0x19, 0x74, 0x45, 0x58, 0x74, 0x53, 0x6f, 0x66, 0x74, 0x77, 0x61, 0x72,
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  0xee, 0xca, 0x37, 0x5b, 0x00, 0x00, 0x00, 0x00, 0x49, 0x45, 0x4e, 0x44, 0xae, 0x42, 0x60, 0x82,
};


static const int CLOCK_W = 8;
static const int CLOCK_H = 10;


void EffectClock::init(Display& display) {
  Effect::init(display);

  _image_clock = new Image(Image::IMAGE_PNG, IMAGE_CLOCK, sizeof(IMAGE_CLOCK) / sizeof(IMAGE_CLOCK[0]), true);

  sync();
}


void EffectClock::process(Display& display) {
  static const int OFFSET_X = 22;
  static const int OFFSET_Y = 11;

  if (!Protogen.getStaticMode()) {
    sync();
  }

  display.draw_image_newcolor_ex(_image_clock, _colorFunc, 0, DRAW_SINGLE, OFFSET_X + (CLOCK_W * 0), OFFSET_Y, CLOCK_W, CLOCK_H, _hour / 10 * CLOCK_W, 0);
  display.draw_image_newcolor_ex(_image_clock, _colorFunc, 0, DRAW_SINGLE, OFFSET_X + (CLOCK_W * 1), OFFSET_Y, CLOCK_W, CLOCK_H, _hour % 10 * CLOCK_W, 0);
  display.draw_image_newcolor_ex(_image_clock, _colorFunc, 0, DRAW_SINGLE, HUB75_PANEL_RES_X + (CLOCK_W * 0), OFFSET_Y, CLOCK_W, CLOCK_H, _hour / 10 * CLOCK_W, 0);
  display.draw_image_newcolor_ex(_image_clock, _colorFunc, 0, DRAW_SINGLE, HUB75_PANEL_RES_X + (CLOCK_W * 1), OFFSET_Y, CLOCK_W, CLOCK_H, _hour % 10 * CLOCK_W, 0);

  if (_blink == 0) {
    display.draw_image_newcolor_ex(_image_clock, _colorFunc, 0, DRAW_SINGLE, OFFSET_X + (CLOCK_W * 2), OFFSET_Y, CLOCK_W, CLOCK_H, 10 * CLOCK_W, 0);
    display.draw_image_newcolor_ex(_image_clock, _colorFunc, 0, DRAW_SINGLE, HUB75_PANEL_RES_X + (CLOCK_W * 2), OFFSET_Y, CLOCK_W, CLOCK_H, 10 * CLOCK_W, 0);
  }

  display.draw_image_newcolor_ex(_image_clock, _colorFunc, 0, DRAW_SINGLE, OFFSET_X + (CLOCK_W * 3), OFFSET_Y, CLOCK_W, CLOCK_H, _minute / 10 * CLOCK_W, 0);
  display.draw_image_newcolor_ex(_image_clock, _colorFunc, 0, DRAW_SINGLE, OFFSET_X + (CLOCK_W * 4), OFFSET_Y, CLOCK_W, CLOCK_H, _minute % 10 * CLOCK_W, 0);
  display.draw_image_newcolor_ex(_image_clock, _colorFunc, 0, DRAW_SINGLE, HUB75_PANEL_RES_X + (CLOCK_W * 3), OFFSET_Y, CLOCK_W, CLOCK_H, _minute / 10 * CLOCK_W, 0);
  display.draw_image_newcolor_ex(_image_clock, _colorFunc, 0, DRAW_SINGLE, HUB75_PANEL_RES_X + (CLOCK_W * 4), OFFSET_Y, CLOCK_W, CLOCK_H, _minute % 10 * CLOCK_W, 0);
}


void EffectClock::release(Display& display) {
  if (_image_clock != nullptr) {
    delete _image_clock;
    _image_clock = nullptr;
  }

  Effect::release(display);
}


void EffectClock::sync() {
  _hour = Protogen._rtc.getHour();
  _minute = Protogen._rtc.getMinute();
  // _second = Protogen._rtc.getSecond();
  _blink = Protogen._rtc.getBlink();
}


};
