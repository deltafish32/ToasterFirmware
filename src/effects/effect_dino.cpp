#include "effect_dino.h"
#include "lib/logger.h"
#include "protogen.h"


namespace toaster {


enum {
	STATE_INIT = 0,
	STATE_RUN,
	STATE_GAMEOVER,
};


static const uint8_t PROGMEM IMAGE_DINO[] = {
  0x89, 0x50, 0x4e, 0x47, 0x0d, 0x0a, 0x1a, 0x0a, 0x00, 0x00, 0x00, 0x0d, 0x49, 0x48, 0x44, 0x52,
  0x00, 0x00, 0x00, 0x40, 0x00, 0x00, 0x00, 0x40, 0x08, 0x06, 0x00, 0x00, 0x00, 0xaa, 0x69, 0x71,
  0xde, 0x00, 0x00, 0x00, 0x19, 0x74, 0x45, 0x58, 0x74, 0x53, 0x6f, 0x66, 0x74, 0x77, 0x61, 0x72,
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  0x44, 0xae, 0x42, 0x60, 0x82,
};


static const int DINO_W = 16;
static const int DINO_H = 16;

static const int DINO_JUMP_SX = 0;
static const int DINO_JUMP_SY = 0;

static const int DINO_DED_SX = 16;
static const int DINO_DED_SY = 0;

static const int DINO_RUN_SX[] = {0, 16, };
static const int DINO_RUN_SY[] = {16, 16, };

typedef struct _CACTUS {
  uint8_t w;
  uint8_t h;
  uint8_t sx;
  uint8_t sy;
} CACTUS;

typedef struct _TILE {
  uint8_t sx;
  uint8_t sy;
  uint16_t rarity;
} TILE;

static const CACTUS CACTUS_DATA[] = {
  { 8, 16, 32, 0, },
  { 8, 16, 40, 0, },
  { 16, 16, 48, 0, },
  { 16, 16, 32, 16, },
};

static const int CACTUS_TYPE_COUNT = sizeof(CACTUS_DATA) / sizeof(CACTUS_DATA[0]);

static const int TILE_W = 8;
static const int TILE_H = 8;

static const TILE TILE_DATA[] = {
  { 32, 32, 10, },
  { 40, 32, 100, },
  { 48, 32, 100, },
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  { 56, 40, 10, },
};

static const int TILE_TYPE_COUNT = sizeof(TILE_DATA) / sizeof(TILE_DATA[0]);

static const int SCORE_W = 3;
static const int SCORE_H = 5;
static const int SCORE_SX = 0;
static const int SCORE_SY = 32;

static const int GAMEOVER_W = 24;
static const int GAMEOVER_H = 16;
static const int GAMEOVER_SX = 0;
static const int GAMEOVER_SY = 48;



// g = 9.8, v = 2.0, fps = 180
static const float JUMP_LUT[] = {
  0.052994f, 0.104547f, 0.154655f, 0.203322f, 0.250545f, 0.296327f, 0.340664f, 0.383561f, 0.425012f, 0.465023f,
  0.503589f, 0.540715f, 0.576400f, 0.610640f, 0.643435f, 0.674789f, 0.704703f, 0.733172f, 0.760201f, 0.785784f,
  0.809927f, 0.832625f, 0.853883f, 0.873695f, 0.892067f, 0.908994f, 0.924480f, 0.938526f, 0.951127f, 0.962283f,
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  0.177677f, 0.128246f, 0.077370f, 0.025054f,
};

static const int JUMP_FRAMES = sizeof(JUMP_LUT) / sizeof(JUMP_LUT[0]);

static const timer_ms_t MIN_BLOCK_TIME_MS = 1500;
static const timer_ms_t MAX_BLOCK_TIME_MS = 3000;
static const timer_ms_t RESTART_TIME_MS = 1000;


bool DinoCactus::hittest(int x, int y) {
  int dino_x_expand = 2;
  int dino_y = y + 8;
  return _hitable
      && (x + dino_x_expand >= _x - CACTUS_DATA[_type].w / 2 && x - dino_x_expand < _x + CACTUS_DATA[_type].w / 2)
      && (dino_y - (_y + _height * 1 / 4) > 0);
}


void DinoCactus::draw(Display& display, EffectDino& dino) {
  display.draw_image_newcolor_ex(dino._image_dino, dino._colorFunc, 0, DRAW_MIRROR, 
    _x - CACTUS_DATA[_type].h / 2, _y, CACTUS_DATA[_type].w, CACTUS_DATA[_type].h, CACTUS_DATA[_type].sx, CACTUS_DATA[_type].sy);
}


void EffectDino::init(Display& display) {
  Effect::init(display);

  _state = STATE_INIT;
  _frame = 0;
  _jumping = false;
  _jump_frame = 0;
  _score = 0;
  _tile_x = 0;
  _next_block_time = Timer::get_millis() + MAX_BLOCK_TIME_MS;
  _prev_static_mode = getStaticMode();
  setStaticMode(true);

  _objects.clear();
  generateTile(true);
  
  _image_dino = new Image(Image::IMAGE_PNG, IMAGE_DINO, sizeof(IMAGE_DINO) / sizeof(IMAGE_DINO[0]), true);
}


void EffectDino::process(Display& display) {
  processGames();
  drawGames(display);

  ++_frame;
}


void EffectDino::release(Display& display) {
  if (_image_dino != nullptr) {
    delete _image_dino;
    _image_dino = nullptr;
  }

  setStaticMode(_prev_static_mode);

  Effect::release(display);
}


int EffectDino::getDinoX() {
  return 22;
}


int EffectDino::getDinoY() {
  return 16 - (_jumping ? (int)(JUMP_LUT[_jump_frame] * 16) : 0);
}


void EffectDino::drawGames(Display& display) {
  const int dino_x = getDinoX();
  const int dino_y = getDinoY();
  int dino_sx = 0;
  int dino_sy = 0;
  
  for (int i = 0; i < _tiles.size(); i++) {
    int tile_type = _tiles[i];
    display.draw_image_newcolor_ex(_image_dino, _colorFunc, 0, DRAW_MIRROR, 
      0 - _tile_x + i * TILE_W, HUB75_PANEL_RES_Y - TILE_H, TILE_W, TILE_H, TILE_DATA[tile_type].sx, TILE_DATA[tile_type].sy);
  }

  for (const auto& obj : _objects) {
    obj->draw(display, *this);
  }

  switch (_state) {
  case STATE_INIT:
    dino_sx = DINO_JUMP_SX;
    dino_sy = DINO_JUMP_SY;
    break;
  case STATE_RUN: {
      int run_frame = (Timer::get_millis() - _jump_time) / 250 % 2;
      dino_sx = _jumping ? DINO_JUMP_SX : DINO_RUN_SX[run_frame];
      dino_sy = _jumping ? DINO_JUMP_SY : DINO_RUN_SY[run_frame];
    }
    break;
  case STATE_GAMEOVER:
    dino_sx = DINO_DED_SX;
    dino_sy = DINO_DED_SY;

    display.draw_image_newcolor_ex(_image_dino, _colorFunc, 0, DRAW_SINGLE, 18, 0, GAMEOVER_W, GAMEOVER_H, GAMEOVER_SX, GAMEOVER_SY);
    display.draw_image_newcolor_ex(_image_dino, _colorFunc, 0, DRAW_SINGLE, 66, 0, GAMEOVER_W, GAMEOVER_H, GAMEOVER_SX, GAMEOVER_SY);
    break;
  }
  
  display.draw_image_newcolor_ex(_image_dino, _colorFunc, 0, DRAW_MIRROR, dino_x, dino_y, DINO_W, DINO_H, dino_sx, dino_sy);

  printScore(display, _score);
}


void EffectDino::processGames() {
  if (_jumping == false && Protogen._boopsensor.isBoop()) {
    _jumping = true;
    _jump_frame = 0;
  }

  switch (_state) {
  case STATE_INIT:
    if (_jumping) {
      _state = STATE_RUN;
      _jump_time = Timer::get_millis();
      _next_block_time = Timer::get_millis() + MIN_BLOCK_TIME_MS;
      _objects.clear();
      _frame = 0;
      _score = 0;
      setStaticMode(false);
    }
    break;
  case STATE_RUN:
    for (const auto& obj : _objects) {
      if (obj->hittest(getDinoX() + DINO_W / 2, getDinoY())) {
        _state = STATE_GAMEOVER;
        _ded_time = Timer::get_millis();
        setStaticMode(true);
      }
    }

    if (Timer::get_millis() >= _next_block_time) {
      _next_block_time = Timer::get_millis() + Random::random(MAX_BLOCK_TIME_MS - MIN_BLOCK_TIME_MS) + MIN_BLOCK_TIME_MS;
      generateCactus();
    }

    if ( _jumping) {
      ++_jump_frame;
      if (_jump_frame >= JUMP_FRAMES) {
        _jumping = false;
        _jump_time = Timer::get_millis();
      }
    }

    if (_frame % 2 == 0) {
      ++_tile_x;
      if (_tile_x >= TILE_W) {
        _tile_x = 0;
        generateTile(false);
      }

      for (auto it = _objects.begin(); it != _objects.end(); ) {
        (*it)->process();
        if (!(*it)->_valid) {
          _objects.erase(it);
        }
        else {
          ++it;
        }
      }
    }

    if (_frame % 6 == 0) {
      ++_score;

      if (_score % 100 == 0) {
        _score_highlight = 8;
      }
    }

    if (_frame % 15 == 0 && _score_highlight > 0) {
      --_score_highlight;
    }
    break;
  case STATE_GAMEOVER:
    if (_jumping && Timer::get_millis() - _ded_time >= RESTART_TIME_MS) {
      _state = STATE_RUN;
      _jump_time = Timer::get_millis();
      _objects.clear();
      _next_block_time = _jump_time + MAX_BLOCK_TIME_MS;
      _frame = 0;
      _score = 0;
      setStaticMode(false);
    }
    break;
  }
}


void EffectDino::generateCactus() {
  int type = Random::random(CACTUS_TYPE_COUNT);
  auto cactus = new DinoCactus(type, HUB75_PANEL_RES_X + CACTUS_DATA[type].w / 2, 16, CACTUS_DATA[type].w, CACTUS_DATA[type].h, true);
  _objects.push_back(cactus);
}


void EffectDino::generateTile(bool init) {
  const int TILE_COUNT = HUB75_PANEL_RES_X / TILE_W + 1;

  static std::random_device rd;
  static std::mt19937 gen(_rd());

  static int tile_weights[TILE_TYPE_COUNT];
  if (tile_weights[0] == 0) {
    for (int i = 0; i < TILE_TYPE_COUNT; i++) {
      tile_weights[i] = TILE_DATA[i].rarity;
    }
  }

  static std::discrete_distribution<int> dist(tile_weights, tile_weights + TILE_TYPE_COUNT);

  if (init) {
    _tiles.clear();
    _tiles.assign(TILE_COUNT, 0);

    for (int i = 0; i < TILE_COUNT; i++) {
      _tiles[i] = dist(gen);
    }
  }
  else {
    memmove(&_tiles[0], &_tiles[1], sizeof(int) * (TILE_COUNT - 1));
    _tiles.back() = dist(gen);
  }
}


void EffectDino::printScore(Display& display, int score) {
  int display_score = _score_highlight > 0 ? (score / 100 * 100) : score;

  if (_score_highlight % 2 != 0) {
    return;
  }

  int digit = 0;
  do {
    int n = display_score % 10;
    display.draw_image_newcolor_ex(_image_dino, _colorFunc, 0, DRAW_SINGLE, HUB75_PANEL_RES_X - 1 - (digit + 1) * (SCORE_W + 1), 0, SCORE_W, SCORE_H, SCORE_SX + (n * SCORE_W), SCORE_SY);
    display.draw_image_newcolor_ex(_image_dino, _colorFunc, 0, DRAW_SINGLE, HUB75_PANEL_RES_X - 1 + 48 - (digit + 1) * (SCORE_W + 1), 0, SCORE_W, SCORE_H, SCORE_SX + (n * SCORE_W), SCORE_SY);
    display_score /= 10;
    ++digit;
  } while (display_score > 0);
}


};
