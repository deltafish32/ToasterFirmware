#include "hud_splash.h"
#include "lib/logger.h"
#include "huds.h"


namespace toaster {

static const char* TAG = "HUDSplash";

HUDSplash hud_splash;

#define LOGO_WIDTH    128
#define LOGO_HEIGHT   64

static const unsigned char PROGMEM default_logo_bmp[] = {
  0x00, 0x00, 0x00, 0x00, 0x00, 0x00, 0x00, 0x00, 0x00, 0x00, 0x00, 0x00, 0x00, 0x00, 0x00, 0x00, 
  0x00, 0x00, 0x00, 0x00, 0x00, 0x00, 0x00, 0x00, 0x00, 0x00, 0x00, 0x00, 0x00, 0x00, 0x00, 0x00, 
  0x00, 0x00, 0x00, 0x00, 0x00, 0x00, 0x00, 0x00, 0x00, 0x00, 0x00, 0x00, 0x00, 0x00, 0x00, 0x00, 
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  0x00, 0x00, 0x00, 0x00, 0x00, 0x00, 0x00, 0x00, 0x00, 0x00, 0x00, 0x00, 0x00, 0x00, 0x00, 0x00
};

  
void HUDSplash::init() {
  HUDBase::init();

  _splash = load_png("/png/full/splash.png");
}


void HUDSplash::process(Adafruit_SSD1306& oled) {
  switch (_step) {
  case 0:
    if (_dirty) {
      _dirty = false;
      
      oled.clearDisplay();
      if (_splash == nullptr || false == draw_oled_png(oled, _splash, 0, 0)) {
        oled.drawBitmap(
          (oled.width()  - LOGO_WIDTH ) / 2,
          (oled.height() - LOGO_HEIGHT) / 2,
          default_logo_bmp, LOGO_WIDTH, LOGO_HEIGHT, 1);
      }
      oled.display();
    }
    if (timeout(2000)) {
      nextHUD(&hud_dashboard, true);
    }
    break;
  }
}


void HUDSplash::release() {
  unload_png(_splash);
}


void HUDSplash::pressKey(uint16_t key) {
}


bool HUDSplash::draw_oled_png(Adafruit_SSD1306& oled, upng_t* upng, int offset_x, int offset_y, uint8_t th) {
  if (upng == nullptr) {
    TF_LOG(TAG, "upng draw failed (nullptr).\n");
    return false;
  }

  auto format = upng_get_format(upng);

  if (format != UPNG_RGB8 && format != UPNG_RGBA8) {
    TF_LOG(TAG, "upng unsupported format (%d).\n", format);
    return false;
  }

  auto width = upng_get_width(upng);
  auto height = upng_get_height(upng);
  // auto size = upng_get_size(upng);
  // auto bitdepth = upng_get_bitdepth(upng);
  auto components = upng_get_components(upng);
  auto buffer = upng_get_buffer(upng);
  
  //TF_LOG(TAG, "%d x %d, size: %d, bitdepth: %d, components: %d\n", width, height, size, bitdepth, components);

  for (int y = 0; y < height; y++) {
    for (int x = 0; x < width; x++) {
      int index = (y * width + x) * components;

      uint8_t r1 = buffer[index + 0];
      uint8_t g1 = buffer[index + 1];
      uint8_t b1 = buffer[index + 2];
      uint8_t a = (components >= 4) ? buffer[index + 3] : 255;

      if (a == 0) continue;
      
      if (r1 >= th || g1 >= th || b1 >= th) {
        oled.drawPixel(x + offset_x, y + offset_y, WHITE);
      }
    }
  }

  return true;
}

};
